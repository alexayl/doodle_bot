## firmware/demo/Kconfig
```kconfig
menu "Zephyr"
source "Kconfig.zephyr"
endmenu

# Include driver configurations using APPLICATION_SOURCE_DIR
source "$(APPLICATION_SOURCE_DIR)/../../drivers/Kconfig"

config PERIPHERAL_DEMO
	bool "Build peripheral demo"
	default y
	select SERVO
	select STEPPER_DRIVER
	select PWM_BUZZER
	select SIMPLE_LED_DRIVER
	help
	  Comprehensive peripheral demo showing all robot components:
	  servos, stepper motor, PWM buzzer, and LED.
```

## firmware/drivers/Kconfig
```kconfig
# Copyright (c) 2021 Nordic Semiconductor ASA
# SPDX-License-Identifier: Apache-2.0

menu "Drivers"
rsource "servo/Kconfig"
rsource "led/Kconfig"
rsource "buzzer/Kconfig"
rsource "stepper/Kconfig"
endmenu
```

## firmware/drivers/buzzer/Kconfig
```kconfig
# Copyright (c) 2025 Doodle Bot Project
# SPDX-License-Identifier: Apache-2.0

config BUZZER
	bool "Simple GPIO Buzzer Driver"
	depends on GPIO
	help
	  Enable simple GPIO-based buzzer control driver.
	  Supports basic on/off and timed beep functionality.

config PWM_BUZZER
	bool "PWM Buzzer Driver"
	depends on PWM
	help
	  Enable PWM-based buzzer control driver.
	  Supports frequency control and precise tone generation.
```

## firmware/drivers/led/Kconfig
```kconfig
# Copyright (c) 2025 Doodle Bot Project
# SPDX-License-Identifier: Apache-2.0

config LOCAL_LED_GPIO
	bool "Local LED GPIO Driver"
	depends on GPIO
	help
	  Local copy of Zephyr's LED GPIO driver for testing.
	  Provides basic LED control functionality.
```

## firmware/drivers/servo/Kconfig
```kconfig
config SERVO
	bool "Servo driver"
	default y

config SERVO_INIT_PRIORITY
	int "Servo init priority"
	default 60

config SERVO_LOG_LEVEL
	int "Servo log level"
	default 3

config SERVO_TEST_MODE
	bool "Enable servo test mode"
	default n
	help
	  Enable servo test mode in main application
```

## firmware/drivers/stepper/Kconfig
```kconfig
# SPDX-License-Identifier: Apache-2.0

config DOODLE_A4988_STEPPER
	bool "A4988 Stepper Motor Driver"
	default y
	depends on DT_HAS_DOODLE_A4988_STEPPER_ENABLED
	select STEPPER
	select STEP_DIR_STEPPER
	select STEP_DIR_STEPPER_COUNTER_TIMING if $(dt_node_has_prop,$(dt_nodelabel_path,stepper_left),counter)
	help
	  A4988 stepper driver using Zephyr's step_dir framework.
	  Uses GPIO toggling for step pulses (no PWM interference).
```

## firmware/dts/bindings/sensor/stepper-driver.yaml
```yaml
# Copyright (c) 2025 Doodle Bot Project
# SPDX-License-Identifier: Apache-2.0

description: |
  Stepper motor driver module controller (A4988, DRV8825, etc.)
  
  Controls stepper motors through dedicated driver modules that
  handle current control and microstepping. MS pins are hardwired
  for fixed microstepping configuration.

compatible: "stepper-driver"

properties:
  step-gpio:
    type: phandle
    required: true
    description: GPIO pin for step pulses

  direction-gpio:
    type: phandle
    required: true
    description: GPIO pin for direction control

  enable-gpio:
    type: phandle
    description: GPIO pin for driver enable/disable

  label:
    type: string
    description: Human readable string describing the stepper driver

  steps-per-revolution:
    type: int
    default: 200
    description: Full steps per revolution of the motor

  microsteps:
    type: int
    default: 16
    description: |
      Fixed microstepping factor (1, 2, 4, 8, 16, 32)
      Set by hardwired MS pins on the driver board
      Total steps per revolution = steps-per-revolution * microsteps

  max-speed:
    type: int
    default: 3200
    description: Maximum steps per second (including microstepping)

  acceleration:
    type: int
    default: 1000
    description: Acceleration in steps per second squared
```

## firmware/dts/bindings/servo/doodle-servo.yaml
```yaml
# Devicetree binding for doodle_servo driver

description: Simple servo motor driver using PWM

compatible: "doodle-servo"

include: base.yaml

properties:
  pwms:
    type: phandle-array
    required: true
    description: |
      PWM specifier for the servo motor.
      The PWM period should be 20ms (20000000 ns) for standard servos.
      Example: pwms = <&pwm0 0 20000000 0>;

pwm-cells:
  - channel
  - period
  - flags
```

## firmware/dts/bindings/servo/doodle_servo.yaml
```yaml
# Devicetree binding for doodle_servo driver

description: Simple servo motor driver using PWM

compatible: "doodle_servo"

include: base.yaml

properties:
  label:
    type: string
    description: Human readable string describing the device.

  pwms:
    type: phandle-array
    required: true
    description: |
      PWM specifier for the servo motor.
      The PWM period should be 20ms (20000000 ns) for standard servos.
      Example: pwms = <&pwm0 0 20000000 0>;

pwm-cells:
  - channel
  - period
  - flags
```

## firmware/dts/bindings/stepper/doodle,a4988-stepper.yaml
```yaml
# SPDX-FileCopyrightText: Copyright (c) 2024 DoodleBot
# SPDX-License-Identifier: Apache-2.0

description: |
  A4988 microstepping stepper motor driver.
  A4988 is a microstepping motor driver with built-in translator for easy operation.
  It is designed to operate bipolar stepper motors in full-, half-, quarter-, eighth-,
  and sixteenth-step modes.

  The microstep resolution is typically hardwired via MS1/MS2/MS3 pins, so this driver
  does not control them via GPIO (unlike A4979 or DRV84xx).

  Example:
  stepper_left: stepper_left {
      status = "okay";
      compatible = "doodle,a4988-stepper";
      micro-step-res = <16>;
      invert-direction;
      dir-gpios = <&gpio0 6 GPIO_ACTIVE_HIGH>;
      step-gpios = <&gpio0 5 GPIO_ACTIVE_HIGH>;
      en-gpios = <&gpio0 7 GPIO_ACTIVE_LOW>;
      counter = <&counter0>;
  };

compatible: "doodle,a4988-stepper"

include:
  - name: stepper-controller.yaml

properties:
  step-gpios:
    required: true

  dir-gpios:
    required: true

  en-gpios:
    required: true
```

## firmware/dts/bindings/stepper/stepper-driver.yaml
```yaml
# Copyright (c) 2025 Doodle Bot Project
# SPDX-License-Identifier: Apache-2.0

description: |
  A4988/DRV8825 Stepper Motor Driver
  
  A simple step/direction stepper motor driver for A4988 and DRV8825 controllers.
  These drivers use step pulses for movement, direction pin for rotation direction,
  and enable pin to power the motor.

  Example:
  stepper_left: stepper_left {
      status = "okay";
      compatible = "doodle,a4988-stepper";
      micro-step-res = <16>;
      pwms = <&ledc0 3 20000 0>;           /* PWM for step pulses */
      dir-gpios = <&gpio0 3 GPIO_ACTIVE_HIGH>;
      en-gpios = <&gpio0 4 GPIO_ACTIVE_LOW>;
  };

compatible: "doodle,a4988-stepper"

include:
  - name: stepper-controller.yaml

properties:
  label:
    type: string
    description: Human readable string describing the device.

  pwms:
    required: true
    type: phandle-array
    description: PWM used to generate step signals for the stepper motor.

  dir-gpios:
    required: true
    type: phandle-array
    description: GPIO pins used to control direction of the stepper motor.

  en-gpios:
    required: true
    type: phandle-array
    description: GPIO pins used to enable/disable the stepper motor driver.
```

## firmware/tests/dfplayer/Kconfig
```kconfig
# Configuration for DFPlayer test

config DFPLAYER_TEST
    bool "Enable DFPlayer Mini test"
    default y
    select UART
    select SERIAL
    help
      Enable the DFPlayer Mini audio test application.
      Requires DFPlayer Mini module connected via UART1.

source "Kconfig.zephyr"
```

## firmware/tests/led/Kconfig
```kconfig
menu "Zephyr"
source "Kconfig.zephyr"
endmenu

# Include driver configurations using APPLICATION_SOURCE_DIR
source "$(APPLICATION_SOURCE_DIR)/../../drivers/Kconfig"

config LED_TEST
	bool "Build LED test"
	default y
	select SIMPLE_LED_DRIVER
	help
	  LED test application.
```

## firmware/tests/pwm-buzzer/Kconfig
```kconfig
menu "Zephyr"
source "Kconfig.zephyr"
endmenu

# Include driver configurations using APPLICATION_SOURCE_DIR
source "$(APPLICATION_SOURCE_DIR)/../../drivers/Kconfig"

config PWM_BUZZER_DRIVER_TEST
	bool "Build PWM buzzer test"
	default y
	select PWM_BUZZER
	help
	  PWM buzzer test application.
```

## firmware/tests/servo/Kconfig
```kconfig
menu "Zephyr"
source "Kconfig.zephyr"
endmenu

# Include driver configurations using APPLICATION_SOURCE_DIR
source "$(APPLICATION_SOURCE_DIR)/../../drivers/Kconfig"

config SERVO_TEST
	bool "Build servo test"
	default y
	select SERVO
	help
	  Servo test application.
```

## firmware/tests/stepper/Kconfig
```kconfig
menu "Zephyr"
source "Kconfig.zephyr"
endmenu

# Include driver configurations using APPLICATION_SOURCE_DIR
source "$(APPLICATION_SOURCE_DIR)/../../drivers/Kconfig"

config STEPPER_TEST
	bool "Build stepper test"
	default y
	select STEPPER_DRIVER
	help
	  Stepper motor test application.
```

## west.yml
```yaml
# Copyright (c) 2021 Nordic Semiconductor ASA
# SPDX-License-Identifier: Apache-2.0

manifest:
  self:
    path: doodle-bot

  remotes:
    - name: zephyrproject-rtos
      url-base: https://github.com/zephyrproject-rtos

  projects:
    - name: zephyr
      remote: zephyrproject-rtos
      revision: main
      import:
        # By using name-allowlist we can clone only the modules that are
        # strictly needed by the application.
        name-allowlist:
          - hal_espressif # required for ESP32-based boards

          #- cmsis_6    # required by the ARM port for Cortex-M
          # - hal_nordic # required by the custom_plank board (Nordic based)
          #- hal_stm32  # required by the nucleo_f302r8 board (STM32 based)
```
